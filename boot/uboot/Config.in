## boot/uboot/Config.in
```kconfig
config BR2_TARGET_UBOOT
	bool "U-Boot"
	help
	  Build "Das U-Boot" Boot Monitor

if BR2_TARGET_UBOOT

choice
	prompt "Starterkit i.MX6 board"

config BR2_PACKAGE_HOLA_PC
	bool "Hola-PC"

config BR2_PACKAGE_HOLA_PC_AEEB
	bool "Hola-PC + AEEB"

config BR2_PACKAGE_HOLA_PC_FEB
	bool "Hola-PC + FEB"

config BR2_PACKAGE_HOLA_PC_IEB
	bool "Hola-PC + IEB"

config BR2_PACKAGE_HOLA_PC_VCEB
	bool "Hola-PC + VCEB"

config BR2_PACKAGE_HOLA_PC_RSEB
	bool "Hola-PC + RSEB"

config BR2_PACKAGE_HOLA_DUO_PC
	bool "HolaDuo-PC"

config BR2_PACKAGE_HOLA_DUO_PC_AEEB
	bool "HolaDuo-PC + AEEB"

config BR2_PACKAGE_HOLA_DUO_PC_FEB
	bool "HolaDuo-PC + FEB"

config BR2_PACKAGE_HOLA_DUO_PC_IEB
	bool "HolaDuo-PC + IEB"

config BR2_PACKAGE_HOLA_DUO_PC_VCEB
	bool "HolaDuo-PC + VCEB"

config BR2_PACKAGE_HOLA_DUO_PC_RSEB
	bool "HolaDuo-PC + RSEB"

config BR2_PACKAGE_SK_IMX6Q
	bool "SK-iMX6Q"

config BR2_PACKAGE_SK_IMX6S_OEM
	bool "SK-iMX6S-OEM/-WIFI/-ind"

config BR2_PACKAGE_SK_IMX6S_SODIMM
	bool "SK-iMX6S-SODIMM/-ind"

config BR2_PACKAGE_SK_IMX6D_SODIMM
	bool "SK-iMX6D-SODIMM"

endchoice

config BR2_TARGET_UBOOT_BOARDNAME
	string
	default "hola_solo"      if BR2_PACKAGE_HOLA_PC
	default "hola_solo_aeeb" if BR2_PACKAGE_HOLA_PC_AEEB
	default "hola_solo_feb"  if BR2_PACKAGE_HOLA_PC_FEB
	default "hola_solo_ieb"  if BR2_PACKAGE_HOLA_PC_IEB
	default "hola_solo_vceb" if BR2_PACKAGE_HOLA_PC_VCEB
	default "hola_solo_rseb" if BR2_PACKAGE_HOLA_PC_RSEB
	default "hola_dual"      if BR2_PACKAGE_HOLA_DUO_PC
	default "hola_dual_aeeb" if BR2_PACKAGE_HOLA_DUO_PC_AEEB
	default "hola_dual_feb"  if BR2_PACKAGE_HOLA_DUO_PC_FEB
	default "hola_dual_ieb"  if BR2_PACKAGE_HOLA_DUO_PC_IEB
	default "hola_dual_vceb" if BR2_PACKAGE_HOLA_DUO_PC_VCEB
	default "hola_dual_rseb" if BR2_PACKAGE_HOLA_DUO_PC_RSEB
	default "sk_quad"        if BR2_PACKAGE_SK_IMX6Q
	default "oem_solo"       if BR2_PACKAGE_SK_IMX6S_OEM
	default "sodimm_solo"    if BR2_PACKAGE_SK_IMX6S_SODIMM
	default "sodimm_dual"    if BR2_PACKAGE_SK_IMX6D_SODIMM

config BR2_PACKAGE_SK_DDR528
	depends on !BR2_PACKAGE_HOLA_PC
	depends on !BR2_PACKAGE_HOLA_PC_AEEB
	depends on !BR2_PACKAGE_HOLA_PC_FEB
	depends on !BR2_PACKAGE_HOLA_PC_IEB
	depends on !BR2_PACKAGE_HOLA_PC_VCEB
	depends on !BR2_PACKAGE_SK_IMX6S_OEM
	depends on !BR2_PACKAGE_SK_IMX6S_SODIMM
	bool "switch DDR to 528 MHz"

choice
	prompt "fb0 mode"

config BR2_PACKAGE_FB0_HDMI_FHD
	bool "hdmi,1920x1080"

config BR2_PACKAGE_FB0_HDMI_HD
	bool "hdmi,1280x720"

config BR2_PACKAGE_FB0_LBD_LDB_XGA
	bool "ldb,LDB-XGA"

config BR2_PACKAGE_FB0_LDB_SK_ATM0704
	bool "ldb,SK-ATM0704"

config BR2_PACKAGE_FB0_LCD_LDB_XGA
	bool "lcd,LDB-XGA"

config BR2_PACKAGE_FB0_LCD_SK_ATM0704
	bool "lcd,SK-ATM0704"

config BR2_PACKAGE_FB0_LCD_SK_MI0430
	bool "lcd,SK-MI0430"

endchoice

config BR2_PACKAGE_FB0_DMFC
	depends on BR2_PACKAGE_FB0_HDMI_FHD || BR2_PACKAGE_FB0_HDMI_HD
	bool "enable dmfc=3 for HD video playback"

config BR2_TARGET_UBOOT_FB0
	string
	default "video=mxcfb0:dev=hdmi,1920x1080M@60,if=RGB24" if BR2_PACKAGE_FB0_HDMI_FHD && !BR2_PACKAGE_FB0_DMFC
	default "video=mxcfb0:dev=hdmi,1280x720M@60,if=RGB24"  if BR2_PACKAGE_FB0_HDMI_HD && !BR2_PACKAGE_FB0_DMFC
	default "video=mxcfb0:dev=hdmi,1920x1080M@60,if=RGB24 dmfc=3" if BR2_PACKAGE_FB0_HDMI_FHD && BR2_PACKAGE_FB0_DMFC
	default "video=mxcfb0:dev=hdmi,1280x720M@60,if=RGB24 dmfc=3"  if BR2_PACKAGE_FB0_HDMI_HD && BR2_PACKAGE_FB0_DMFC
	default "video=mxcfb0:dev=ldb,if=RGB666"                if BR2_PACKAGE_FB0_LBD_LDB_XGA
	default "video=mxcfb0:dev=ldb,if=RGB24"                if BR2_PACKAGE_FB0_LDB_SK_ATM0704
	default "video=mxcfb0:dev=lcd,LDB-XGA,if=RGB24"        if BR2_PACKAGE_FB0_LCD_LDB_XGA
	default "video=mxcfb0:dev=lcd,SK-ATM0704,if=RGB24"     if BR2_PACKAGE_FB0_LCD_SK_ATM0704
	default "video=mxcfb0:dev=lcd,SK-MI0430,if=RGB24"      if BR2_PACKAGE_FB0_LCD_SK_MI0430

choice
	prompt "fb1 mode"

config BR2_PACKAGE_FB1_HDMI_FHD
	bool "hdmi,1920x1080"
	depends on !BR2_PACKAGE_FB0_HDMI_FHD
	depends on !BR2_PACKAGE_FB0_HDMI_HD

config BR2_PACKAGE_FB1_HDMI_HD
	bool "hdmi,1280x720"
	depends on !BR2_PACKAGE_FB0_HDMI_FHD
	depends on !BR2_PACKAGE_FB0_HDMI_HD

config BR2_PACKAGE_FB1_LBD_LDB_XGA
	bool "ldb,LDB-XGA"

config BR2_PACKAGE_FB1_LDB_SK_ATM0704
	bool "ldb,SK-ATM0704"

config BR2_PACKAGE_FB1_LCD_LDB_XGA
	bool "lcd,LDB-XGA"
	depends on !BR2_PACKAGE_FB0_LCD_LDB_XGA
	depends on !BR2_PACKAGE_FB0_LCD_SK_ATM0704
	depends on !BR2_PACKAGE_FB0_LCD_SK_MI0430

config BR2_PACKAGE_FB1_LCD_SK_ATM0704
	bool "lcd,SK-ATM0704"
	depends on !BR2_PACKAGE_FB0_LCD_LDB_XGA
	depends on !BR2_PACKAGE_FB0_LCD_SK_ATM0704
	depends on !BR2_PACKAGE_FB0_LCD_SK_MI0430

config BR2_PACKAGE_FB1_LCD_SK_MI0430
	bool "lcd,SK-MI0430"
	depends on !BR2_PACKAGE_FB0_LCD_LDB_XGA
	depends on !BR2_PACKAGE_FB0_LCD_SK_ATM0704
	depends on !BR2_PACKAGE_FB0_LCD_SK_MI0430

endchoice

config BR2_TARGET_UBOOT_FB1
	string
	default "video=mxcfb1:dev=hdmi,1920x1080M@60,if=RGB24" if BR2_PACKAGE_FB1_HDMI_FHD
	default "video=mxcfb1:dev=hdmi,1280x720M@60,if=RGB24"  if BR2_PACKAGE_FB1_HDMI_HD
	default "video=mxcfb1:dev=ldb,if=RGB24"                if BR2_PACKAGE_FB1_LBD_LDB_XGA
	default "video=mxcfb1:dev=ldb,if=RGB24"                if BR2_PACKAGE_FB1_LDB_SK_ATM0704
	default "video=mxcfb1:dev=lcd,LDB-XGA,if=RGB24"        if BR2_PACKAGE_FB1_LCD_LDB_XGA
	default "video=mxcfb1:dev=lcd,SK-ATM0704,if=RGB24"     if BR2_PACKAGE_FB1_LCD_SK_ATM0704
	default "video=mxcfb1:dev=lcd,SK-MI0430,if=RGB24"      if BR2_PACKAGE_FB1_LCD_SK_MI0430

config BR2_TARGET_UBOOT_WATCHDOG
	bool "Enable HW watchdog"

config BR2_TARGET_KERNEL_LVDS
	string
	default "imx6qdl-lvds-1024x768-1024x768.dtsi"   if !BR2_PACKAGE_FB0_LBD_LDB_XGA && !BR2_PACKAGE_FB0_LDB_SK_ATM0704 && !BR2_PACKAGE_FB1_LBD_LDB_XGA && !BR2_PACKAGE_FB1_LDB_SK_ATM0704
	default "imx6qdl-lvds-1024x768-1024x768.dtsi"   if BR2_PACKAGE_FB0_LBD_LDB_XGA && BR2_PACKAGE_FB1_LBD_LDB_XGA
	default "imx6qdl-lvds-800x480-800x480.dtsi"     if BR2_PACKAGE_FB0_LDB_SK_ATM0704 && BR2_PACKAGE_FB1_LDB_SK_ATM0704
	default "imx6qdl-lvds-1024x768-800x480.dtsi"    if BR2_PACKAGE_FB0_LBD_LDB_XGA && BR2_PACKAGE_FB1_LDB_SK_ATM0704
	default "imx6qdl-lvds-800x480-1024x768.dtsi"    if BR2_PACKAGE_FB0_LDB_SK_ATM0704 && BR2_PACKAGE_FB1_LBD_LDB_XGA
	default "imx6qdl-lvds-1024x768-1024x768.dtsi"   if BR2_PACKAGE_FB0_LBD_LDB_XGA && !BR2_PACKAGE_FB1_LBD_LDB_XGA && !BR2_PACKAGE_FB1_LDB_SK_ATM0704
	default "imx6qdl-lvds-1024x768-1024x768.dtsi"   if BR2_PACKAGE_FB1_LBD_LDB_XGA && !BR2_PACKAGE_FB0_LBD_LDB_XGA && !BR2_PACKAGE_FB0_LDB_SK_ATM0704
	default "imx6qdl-lvds-800x480-800x480.dtsi"     if BR2_PACKAGE_FB0_LDB_SK_ATM0704 && !BR2_PACKAGE_FB1_LBD_LDB_XGA && !BR2_PACKAGE_FB1_LDB_SK_ATM0704
	default "imx6qdl-lvds-800x480-800x480.dtsi"     if BR2_PACKAGE_FB1_LDB_SK_ATM0704 && !BR2_PACKAGE_FB0_LBD_LDB_XGA && !BR2_PACKAGE_FB0_LDB_SK_ATM0704

config BR2_TARGET_UBOOT_BOOTDELAY
	int "Boot delay"
        default "1"
	help
	  Wait this number of seconds before execute the contents of the bootcmd variable.

config BR2_TARGET_UBOOT_CUSTOM_BOOT_CMDLINE
	string "advanced kernel options"

choice
	prompt "U-Boot Version"
	help
	  Select the specific U-Boot version you want to use

config BR2_TARGET_UBOOT_LATEST_VERSION
	bool "2014.07"

config BR2_TARGET_UBOOT_CUSTOM_VERSION
	bool "Custom version"
	help
	  This option allows to use a specific official versions

config BR2_TARGET_UBOOT_CUSTOM_TARBALL
	bool "Custom tarball"

config BR2_TARGET_UBOOT_CUSTOM_GIT
	bool "Custom Git repository"

config BR2_TARGET_UBOOT_CUSTOM_HG
	bool "Custom Mercurial repository"

endchoice

config BR2_TARGET_UBOOT_CUSTOM_VERSION_VALUE
	string "U-Boot version"
	depends on BR2_TARGET_UBOOT_CUSTOM_VERSION

config BR2_TARGET_UBOOT_CUSTOM_TARBALL_LOCATION
	string "URL of custom U-Boot tarball"
	depends on BR2_TARGET_UBOOT_CUSTOM_TARBALL

if BR2_TARGET_UBOOT_CUSTOM_GIT || BR2_TARGET_UBOOT_CUSTOM_HG

config BR2_TARGET_UBOOT_CUSTOM_REPO_URL
	string "URL of custom repository"
	default BR2_TARGET_UBOOT_CUSTOM_GIT_REPO_URL \
		if BR2_TARGET_UBOOT_CUSTOM_GIT_REPO_URL != ""  # legacy

config BR2_TARGET_UBOOT_CUSTOM_REPO_VERSION
	string "Custom repository version"
	default BR2_TARGET_UBOOT_CUSTOM_GIT_VERSION \
		if BR2_TARGET_UBOOT_CUSTOM_GIT_VERSION != ""  # legacy
	help
	  Revision to use in the typical format used by Git/Mercurial
	  E.G. a sha id, a tag, branch, ..

endif

config BR2_TARGET_UBOOT_VERSION
	string
	default "2014.07"	if BR2_TARGET_UBOOT_LATEST_VERSION
	default BR2_TARGET_UBOOT_CUSTOM_VERSION_VALUE \
		if BR2_TARGET_UBOOT_CUSTOM_VERSION
	default "custom"	if BR2_TARGET_UBOOT_CUSTOM_TARBALL
	default BR2_TARGET_UBOOT_CUSTOM_REPO_VERSION \
		if BR2_TARGET_UBOOT_CUSTOM_GIT || BR2_TARGET_UBOOT_CUSTOM_HG

config BR2_TARGET_UBOOT_CUSTOM_PATCH_DIR
	string "custom patch dir"
	help
	  If your board requires custom patches, add the path to the
	  directory containing the patches here. The patches must be
	  named uboot-<something>.patch.

	  Most users may leave this empty

choice
	prompt "U-Boot binary format"
	default BR2_TARGET_UBOOT_FORMAT_BIN

config BR2_TARGET_UBOOT_FORMAT_AIS
	bool "u-boot.ais"
	help
	  AIS (Application Image Script) is a format defined by TI.
	  It is required to load code/data on OMAP-L1 processors.
	  u-boot.ais contains U-Boot with the SPL support.

config BR2_TARGET_UBOOT_FORMAT_BIN
	bool "u-boot.bin"

config BR2_TARGET_UBOOT_FORMAT_IMG
	bool "u-boot.img"

config BR2_TARGET_UBOOT_FORMAT_IMX
	bool "u-boot.imx"

config BR2_TARGET_UBOOT_FORMAT_NAND_BIN
	bool "u-boot-nand.bin"

config BR2_TARGET_UBOOT_FORMAT_KWB
	depends on BR2_arm
	bool "u-boot.kwb (Marvell)"

config BR2_TARGET_UBOOT_FORMAT_LDR
	depends on BR2_bfin
	bool "u-boot.ldr"

config BR2_TARGET_UBOOT_FORMAT_ELF
	bool "u-boot.elf"

config BR2_TARGET_UBOOT_FORMAT_SB
	depends on BR2_arm
	bool "u-boot.sb"

config BR2_TARGET_UBOOT_FORMAT_CUSTOM
	bool "Custom (specify below)"
	help
	  On some platforms, the standard U-Boot binary is not called
	  u-boot.bin, but u-boot<something>.bin. If this is your case,
	  you should select this option and specify the correct name
	  in BR2_TARGET_UBOOT_FORMAT_CUSTOM_NAME.

endchoice

config BR2_TARGET_UBOOT_FORMAT_CUSTOM_NAME
	string "U-Boot binary format: custom name"
	depends on BR2_TARGET_UBOOT_FORMAT_CUSTOM
	help
	  Specify the correct name of the output binary created by
	  U-Boot, if it is not one of the default names. For example:
	  u-boot_magic.bin

config BR2_TARGET_UBOOT_OMAP_IFT
	depends on BR2_TARGET_UBOOT_FORMAT_BIN
	depends on BR2_arm || BR2_armeb
	select BR2_PACKAGE_HOST_OMAP_U_BOOT_UTILS
	bool "produce a .ift signed image (OMAP)"
	help
	  Use gpsign to produce an image of u-boot.bin signed with
	  a Configuration Header for booting on OMAP processors.
	  This allows U-Boot to boot without the need for an
	  intermediate bootloader (e.g. x-loader) if it is written
	  on the first sector of the boot medium.
	  This only works for some media, such as NAND. Check your
	  chip documentation for details. You might also want to
	  read the documentation of gpsign, the tool that generates
	  the .ift image, at:
	  https://github.com/nmenon/omap-u-boot-utils/blob/master/README

if BR2_TARGET_UBOOT_OMAP_IFT

config BR2_TARGET_UBOOT_OMAP_IFT_CONFIG
	string "gpsign Configuration Header config file"
	help
	  The Configuration Header (CH) config file defines the
	  desired content of the CH for the signed image.
	  It usually contains external RAM settings and
	  possibly other external devices initialization.
	  The omap-u-boot-utils software contains example
	  configuration files for some boards:
	  https://github.com/nmenon/omap-u-boot-utils/tree/master/configs

endif

menuconfig BR2_TARGET_UBOOT_NETWORK
	bool "Custom Network Settings"
	depends on BR2_DEPRECATED_SINCE_2014_05
	help
	  Custom network settings for U-boot

if BR2_TARGET_UBOOT_NETWORK

config BR2_TARGET_UBOOT_SERVERIP
	string "server ip"
	default "10.175.196.221"
	help
	  TFTP server ip address

config BR2_TARGET_UBOOT_IPADDR
	string "ip address"
	default "10.175.196.18"
	help
	  Target ip address

config BR2_TARGET_UBOOT_GATEWAY
	string "gateway ip"
	default "10.175.196.1"
	help
	  Gateway ip address

config BR2_TARGET_UBOOT_NETMASK
	string "netmask"
	default "255.255.255.0"
	help
	  Network Mask

config BR2_TARGET_UBOOT_ETHADDR
	string "ethernet address"
	default "04:25:fe:ed:00:18"
	help
	  Target MAC address for the ethernet interface.
	  This should be changed for production units

config BR2_TARGET_UBOOT_ETH1ADDR
	string "ethernet 2 address"
	help
	  Target MAC address for the second ethernet interface.

endif # BR2_TARGET_UBOOT_NETWORK

config BR2_TARGET_UBOOT_SPL
	bool "U-Boot SPL support"
	depends on !BR2_TARGET_XLOADER
	help
	  Enable the U-Boot SPL support. SPL is a first stage
	  bootloader loaded into internal memory in charge of
	  enabling and configuring the external memory (DDR),
	  and load the u-boot program into DDR.

config BR2_TARGET_UBOOT_SPL_NAME
	string "U-Boot SPL target name"
	default "spl/u-boot-spl.bin"
	depends on BR2_TARGET_UBOOT_SPL
	help
	  This is the name of the SPL binary, generated during
	  u-boot build. For most platform it is spl/u-boot-spl.bin
	  but not always. It is MLO on OMAP for example.

menuconfig BR2_TARGET_UBOOT_ENVIMAGE
	bool "Environment image"
	help
	  Generate a valid binary environment image from a text file
	  describing the key=value pairs of the environment.

	  The environment image will be called uboot-env.bin.

if BR2_TARGET_UBOOT_ENVIMAGE

config BR2_TARGET_UBOOT_ENVIMAGE_SOURCE
	string "Source file for environment"
	help
	  Text file describing the environment.

config BR2_TARGET_UBOOT_ENVIMAGE_SIZE
	string "Size of environment"
	help
	  Size of envronment, can be prefixed with 0x for hexadecimal
	  values.

config BR2_TARGET_UBOOT_ENVIMAGE_REDUNDANT
	bool "Environment has two copies"
	help
	  Some platforms define in their U-Boot configuration that the
	  U-Boot environment should be duplicated in two locations (for
	  extra safety). Check your U-Boot configuration for the
	  CONFIG_ENV_ADDR_REDUND and CONFIG_ENV_SIZE_REDUND settings to
	  see if this is the case for your platform.

	  If it is the case, then you should enable this option to
	  ensure that the U-Boot environment image generated by
	  Buildroot is compatible with the "redundant environment"
	  mechanism of U-Boot.

endif # BR2_TARGET_UBOOT_ENVIMAGE

endif # BR2_TARGET_UBOOT
```

## package/freescale-imx/gst-variable-rtsp-server/Config.in
```kconfig
config BR2_PACKAGE_GST_VARIABLE_RTSP_SERVER
	bool "gst-variable-rtsp-server"
	select BR2_PACKAGE_GST1_RTSP_SERVER
	help
	  RTSP server.

	  https://github.com/Gateworks/gst-gateworks-apps
```
